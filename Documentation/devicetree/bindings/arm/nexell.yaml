## Documentation/devicetree/bindings/thermal/nexell,s5p6818-tmu.yaml
```yaml
# SPDX-License-Identifier: (GPL-2.0-only OR BSD-2-Clause)
%YAML 1.2
---
$id: http://devicetree.org/schemas/thermal/nexell,s5p6818-tmu.yaml#
$schema: http://devicetree.org/meta-schemas/core.yaml#

title: Nexell S5P6818 internal temperature monitor

maintainers:
  - liy <liygfg@gmail.com>

description: |
  Two TMU instances measure internal die temperature. The driver uses
  factory one-point calibration at 25 degrees Celsius and polling.
  nexell,tieoff references the shared four-byte trim sensing register at
  0xc0011130. Channel 0 and 1 use SENSING_START bits 0 and 1 and
  SENSING_DONE bits 3 and 4 respectively. This operation reads trim
  latches and does not program nonvolatile fuses.

$ref: thermal-sensor.yaml#

properties:
  compatible:
    const: nexell,s5p6818-tmu
  reg:
    maxItems: 1
  clocks:
    maxItems: 1
  clock-names:
    const: tmu_apbif
  nexell,tieoff:
    $ref: /schemas/types.yaml#/definitions/phandle
    description: Shared trim sensing syscon at 0xc0011130.
  nexell,channel:
    $ref: /schemas/types.yaml#/definitions/uint32
    enum: [0, 1]
    description: TMU instance index.
  '#thermal-sensor-cells':
    const: 0

required:
  - compatible
  - reg
  - clocks
  - clock-names
  - nexell,tieoff
  - nexell,channel
  - '#thermal-sensor-cells'

unevaluatedProperties: false
```

## Documentation/devicetree/bindings/timer/nexell,s5p6818-timer.yaml
```yaml
# SPDX-License-Identifier: (GPL-2.0-only OR BSD-2-Clause)
%YAML 1.2
---
$id: http://devicetree.org/schemas/timer/nexell,s5p6818-timer.yaml#
$schema: http://devicetree.org/meta-schemas/core.yaml#

title: Nexell S5P6818 Timer

maintainers:
  - liy <liygfg@gmail.com>

description: |
  The S5P6818 timer block provides a 32-bit down-counter driven by a
  prescaled bus clock.  Linux uses it as both clocksource and clockevent.

properties:
  compatible:
    const: nexell,s5p6818-timer

  reg:
    maxItems: 1

  interrupts:
    maxItems: 1

  clocks:
    maxItems: 1

  clock-names:
    const: timer

  resets:
    maxItems: 1

  reset-names:
    const: timer

  nexell,pclk-frequency:
    $ref: /schemas/types.yaml#/definitions/uint32
    description: bus PCLK in Hz that feeds the timer prescaler

  clock-frequency:
    $ref: /schemas/types.yaml#/definitions/uint32
    description: resulting timer tick rate in Hz after the prescaler

required:
  - compatible
  - reg
  - interrupts
  - clocks
  - clock-names
  - resets
  - reset-names
  - nexell,pclk-frequency
  - clock-frequency

additionalProperties: false

examples:
  - |
    #include <dt-bindings/interrupt-controller/irq.h>
    #include <dt-bindings/interrupt-controller/arm-gic.h>
    #include <dt-bindings/clock/nexell,s5p6818-clock.h>
    #include <dt-bindings/reset/nexell,s5p6818-reset.h>
    timer@c0017000 {
        compatible = "nexell,s5p6818-timer";
        reg = <0xc0017000 0x1000>;
        interrupts = <GIC_SPI 24 IRQ_TYPE_LEVEL_HIGH>;
        clocks = <&clocks NEXELL_CLK_TIMER0>;
        clock-names = "timer";
        resets = <&nexell_reset RESET_ID_TIMER>;
        reset-names = "timer";
        nexell,pclk-frequency = <200000000>;
        clock-frequency = <10000000>;
    };
```

## Documentation/devicetree/bindings/usb/nexell,s5p6818-usb.yaml
```yaml
# SPDX-License-Identifier: (GPL-2.0-only OR BSD-2-Clause)
%YAML 1.2
---
$id: http://devicetree.org/schemas/usb/nexell,s5p6818-usb.yaml#
$schema: http://devicetree.org/meta-schemas/core.yaml#

title: Nexell S5P6818 USB 2.0 Host Controllers

maintainers:
  - liy <liygfg@gmail.com>

description: |
  The S5P6818 EHCI and OHCI host controllers use the shared USB 2.0 PHY
  described by nexell,s5p6818-usb2-phy.yaml.

select:
  properties:
    compatible:
      enum:
        - nexell,s5p6818-ehci
        - nexell,s5p6818-ohci
  required:
    - compatible

allOf:
  - $ref: usb-hcd.yaml#

properties:
  compatible:
    enum:
      - nexell,s5p6818-ehci
      - nexell,s5p6818-ohci

  phys:
    maxItems: 1

  phy-names:
    const: usb2-phy

  companion:
    $ref: /schemas/types.yaml#/definitions/phandle
    description: phandle of the paired OHCI companion for EHCI

required:
  - compatible
  - phys
  - phy-names

unevaluatedProperties: false

examples:
  - |
    #include <dt-bindings/interrupt-controller/arm-gic.h>
    usb@c0030000 {
        compatible = "nexell,s5p6818-ehci";
        reg = <0xc0030000 0x1000>;
        interrupts = <GIC_SPI 50 IRQ_TYPE_LEVEL_HIGH>;
        phys = <&usb_host_phy 0>;
        phy-names = "usb2-phy";
        companion = <&ohci>;
    };
```

## Documentation/devicetree/bindings/watchdog/nexell,s5p6818-wdt.yaml
```yaml
# SPDX-License-Identifier: (GPL-2.0-only OR BSD-2-Clause)
%YAML 1.2
---
$id: http://devicetree.org/schemas/watchdog/nexell,s5p6818-wdt.yaml#
$schema: http://devicetree.org/meta-schemas/core.yaml#

title: Nexell S5P6818 Watchdog Timer

maintainers:
  - liy <liygfg@gmail.com>

description: |
  The S5P6818 watchdog timer is clocked from the 200 MHz bus PCLK rather
  than a dedicated oscillator.  The driver derives the tick rate from the
  nexell,wdt-frequency property.

properties:
  compatible:
    const: nexell,s5p6818-wdt

  reg:
    maxItems: 1

  clocks:
    maxItems: 1

  clock-names:
    const: watchdog

  resets:
    items:
      - description: watchdog POR reset
      - description: watchdog reset

  reset-names:
    items:
      - const: wdt-por
      - const: wdt

  nexell,wdt-frequency:
    $ref: /schemas/types.yaml#/definitions/uint32
    description: watchdog clock frequency in Hz

required:
  - compatible
  - reg
  - resets
  - reset-names
  - nexell,wdt-frequency

additionalProperties: false

examples:
  - |
    watchdog@c0019000 {
        compatible = "nexell,s5p6818-wdt";
        reg = <0xc0019000 0x1000>;
        resets = <&nexell_reset 60>, <&nexell_reset 61>;
        reset-names = "wdt-por", "wdt";
        nexell,wdt-frequency = <200000000>;
    };
```

## arch/arm/mach-nexell/Kconfig
```kconfig
# SPDX-License-Identifier: GPL-2.0-only

config ARCH_NEXELL
	bool "Nexell S5P6818 SoC support"
	depends on ARCH_MULTI_V7
	select ARM_AMBA
	select ARM_GIC
	select ARM_CCI400_COMMON
	select COMMON_CLK
	select GENERIC_CLOCKEVENTS
	select HAVE_SMP
	select OF
	select PINCTRL
	select RESET_CONTROLLER
	select SOC_NEXELL_S5P6818
	help
	  Support for the Nexell S5P6818 ARM Cortex-A53 SoC.
```

## arch/arm64/configs/x6818_arm64_defconfig
```kconfig
CONFIG_ARCH_NEXELL_S5P6818=y
CONFIG_SMP=y
CONFIG_NR_CPUS=8
CONFIG_HOTPLUG_CPU=y
CONFIG_COMPAT=y
CONFIG_BLK_DEV_INITRD=y
CONFIG_DEVTMPFS=y
CONFIG_DEVTMPFS_MOUNT=y
CONFIG_NET=y
CONFIG_INET=y
CONFIG_NETDEVICES=y
CONFIG_NET_VENDOR_STMICRO=y
CONFIG_PHYLIB=y
CONFIG_REALTEK_PHY=y
CONFIG_STMMAC_ETH=y
CONFIG_STMMAC_PLATFORM=y
CONFIG_DWMAC_NEXELL=y
CONFIG_MMC=y
CONFIG_MMC_BLOCK=y
CONFIG_MMC_DW=y
CONFIG_MMC_DW_PLTFM=y
CONFIG_MMC_DW_NEXELL=y
CONFIG_USB=y
CONFIG_USB_EHCI_HCD=y
CONFIG_USB_EHCI_HCD_NEXELL=y
CONFIG_USB_OHCI_HCD=y
CONFIG_USB_OHCI_HCD_NEXELL=y
CONFIG_USB_STORAGE=y
CONFIG_SCSI=y
CONFIG_BLK_DEV_SD=y
CONFIG_FB=y
CONFIG_FB_DEVICE=y
CONFIG_FB_SIMPLE=y
CONFIG_FRAMEBUFFER_CONSOLE=y
CONFIG_VIDEO_NEXELL_S5P6818=y
CONFIG_COMMON_CLK_NEXELL=y
CONFIG_RESET_NEXELL=y
# CONFIG_NEXELL_TIMER is not set
CONFIG_WATCHDOG=y
CONFIG_NEXELL_WDT=y
CONFIG_SERIAL_SAMSUNG=y
CONFIG_SERIAL_SAMSUNG_UARTS=6
CONFIG_SERIAL_SAMSUNG_CONSOLE=y
CONFIG_PINCTRL_NEXELL=y
CONFIG_INPUT_KEYBOARD=y
CONFIG_KEYBOARD_GPIO=y
CONFIG_INPUT_EVDEV=y
CONFIG_NEW_LEDS=y
CONFIG_LEDS_CLASS=y
CONFIG_LEDS_GPIO=y
CONFIG_LEDS_TRIGGERS=y
CONFIG_LEDS_TRIGGER_HEARTBEAT=y
CONFIG_INPUT_TOUCHSCREEN=y
CONFIG_TOUCHSCREEN_SILEAD=y
CONFIG_INPUT_MISC=y
CONFIG_INPUT_GPIO_BEEPER=y
CONFIG_RC_CORE=y
CONFIG_RC_DEVICES=y
CONFIG_IR_GPIO_CIR=y
CONFIG_I2C=y
CONFIG_I2C_CHARDEV=y
CONFIG_I2C_S3C2410=y
CONFIG_WIRELESS=y
CONFIG_CFG80211=y
CONFIG_MAC80211=y
CONFIG_WLAN=y
CONFIG_WLAN_VENDOR_REALTEK=y
CONFIG_RTL8XXXU=m
CONFIG_RTL8XXXU_UNTESTED=y
CONFIG_BT=m
CONFIG_BT_HCIBTUSB=m
CONFIG_BT_HCIBTUSB_RTL=y
CONFIG_PRINTK_TIME=y
CONFIG_MAGIC_SYSRQ=y
CONFIG_CMDLINE="console=ttySAC0,115200n8 earlycon=s5p6818,mmio,0xc00a1000"
CONFIG_CMDLINE_FROM_BOOTLOADER=y
CONFIG_GPIOLIB_IRQCHIP=y
```

## arch/arm64/configs/x6818_arm64_nexell_timer_defconfig
```kconfig
# Experimental fallback target: use the Nexell timer when the architectural
# counter is unavailable. The product defconfig remains arch-timer based.
CONFIG_ARCH_NEXELL_S5P6818=y
CONFIG_SMP=y
CONFIG_NR_CPUS=8
CONFIG_COMPAT=y
CONFIG_BLK_DEV_INITRD=y
CONFIG_DEVTMPFS=y
CONFIG_DEVTMPFS_MOUNT=y
CONFIG_TMPFS=y
CONFIG_NET=y
CONFIG_INET=y
CONFIG_NETDEVICES=y
CONFIG_NET_VENDOR_STMICRO=y
CONFIG_PHYLIB=y
CONFIG_REALTEK_PHY=y
CONFIG_STMMAC_ETH=y
CONFIG_STMMAC_PLATFORM=y
CONFIG_DWMAC_NEXELL=y
CONFIG_MMC=y
CONFIG_MMC_BLOCK=y
CONFIG_MMC_DW=y
CONFIG_MMC_DW_PLTFM=y
CONFIG_MMC_DW_NEXELL=y
CONFIG_USB=y
CONFIG_USB_EHCI_HCD=y
CONFIG_USB_EHCI_HCD_NEXELL=y
CONFIG_USB_OHCI_HCD=y
CONFIG_USB_OHCI_HCD_NEXELL=y
CONFIG_USB_STORAGE=y
CONFIG_SCSI=y
CONFIG_BLK_DEV_SD=y
CONFIG_FB=y
CONFIG_FB_SIMPLE=y
CONFIG_FRAMEBUFFER_CONSOLE=y
CONFIG_VIDEO_NEXELL_S5P6818=y
CONFIG_COMMON_CLK_NEXELL=y
CONFIG_RESET_NEXELL=y
CONFIG_NEXELL_TIMER=y
CONFIG_WATCHDOG=y
CONFIG_NEXELL_WDT=y
CONFIG_SERIAL_SAMSUNG=y
CONFIG_SERIAL_SAMSUNG_UARTS=6
CONFIG_SERIAL_SAMSUNG_CONSOLE=y
CONFIG_PINCTRL_NEXELL=y
CONFIG_PRINTK_TIME=y
CONFIG_MAGIC_SYSRQ=y
CONFIG_CMDLINE="console=ttySAC0,115200n8 earlycon=s5p6818,mmio,0xc00a1000"
CONFIG_CMDLINE_FROM_BOOTLOADER=y
```

## drivers/clk/nexell/Kconfig
```kconfig
# SPDX-License-Identifier: GPL-2.0

config COMMON_CLK_NEXELL
	bool "Nexell S5P6818 clock support"
	depends on (ARCH_NEXELL || COMPILE_TEST) && OF
	default ARCH_NEXELL
	help
	  Enable the Common Clock Framework provider for the Nexell S5P6818.
	  The driver reads the PLL state left by the boot ROM/U-Boot and exposes
	  the S5P6818 CLKGEN peripheral clocks with standard clock cells.
```

## drivers/media/platform/nexell/Kconfig
```kconfig
# SPDX-License-Identifier: GPL-2.0-only
config VIDEO_NEXELL_CAPTURE
	tristate "Nexell S5P6818 CSI-2/VIP capture"
	depends on VIDEO_DEV && OF && HAS_DMA
	depends on ARCH_NEXELL_S5P6818 || COMPILE_TEST
	select MEDIA_CONTROLLER
	select VIDEO_V4L2_SUBDEV_API
	select V4L2_FWNODE
	select VIDEOBUF2_DMA_CONTIG
	help
	  CSI-2 receiver and VIP0 DMA capture for the S5P6818. Supports
	  a two-lane UYVY sensor and packed YUYV buffers through V4L2.
```

## drivers/phy/nexell/Kconfig
```kconfig
# SPDX-License-Identifier: GPL-2.0-only
config PHY_NEXELL_USB2
	tristate "Nexell S5P6818 USB 2.0 PHY"
	depends on OF && ARCH_NEXELL
	select GENERIC_PHY
	select RESET_CONTROLLER
	help
	  Enable support for the shared USB 2.0 host PHY found in the Nexell
	  S5P6818 SoC. The PHY is shared by the EHCI and OHCI host controllers
	  and manages their common clocks, reset, and TIEOFF configuration.
```

## drivers/pinctrl/nexell/Kconfig
```kconfig
# SPDX-License-Identifier: GPL-2.0-only

config PINCTRL_NEXELL
	bool "Nexell S5P6818 pinctrl and GPIO driver"
	depends on SOC_NEXELL_S5P6818
	depends on OF
	select PINMUX
	select PINCONF
	select GENERIC_PINCONF
	select GENERIC_PINCTRL_GROUPS
	select GENERIC_PINMUX_FUNCTIONS
	select GPIOLIB
	select GPIOLIB_IRQCHIP
	default y
	help
	  Enable pin multiplexing, pin configuration, and GPIO support for
	  the Nexell S5P6818 GPIO banks.
```

## drivers/soc/nexell/Kconfig
```kconfig
# SPDX-License-Identifier: GPL-2.0-only

config SOC_NEXELL_S5P6818
	bool
	help
	  Common SoC selection for the Nexell S5P6818. Architecture platform
	  code selects this symbol so shared clock, pinctrl, reset, timer, MMC,
	  network, USB, watchdog, serial, and display drivers can be built for
	  either AArch32 or AArch64.

config NEXELL_S5P6818_NO_CROSS_CLUSTER_SEV
	bool "Poll S5P6818 lock waiters when cross-cluster SEV is unavailable"
	depends on SOC_NEXELL_S5P6818 && SMP
	default y
	help
	  The S5P6818 does not deliver a CPU event generated by SEV to the
	  other Cortex-A53 cluster. A lock waiter using WFE can therefore
	  remain asleep after a lock owner in the other cluster releases the
	  lock.

	  Select this option to use polling only in queued spinlock, queued
	  rwlock, and MCS wait paths after an S5P6818 machine is identified.
	  Unlock-side event instructions and non-lock low-power WFE paths are
	  unchanged.
```

## drivers/video/nexell/Kconfig
```kconfig
# SPDX-License-Identifier: GPL-2.0-only

config VIDEO_NEXELL_S5P6818
	bool "Nexell S5P6818 native display scanout"
	depends on ARCH_NEXELL && OF && HAS_IOMEM && RESET_CONTROLLER
	default ARCH_NEXELL
	help
	  Validate and reapply the S5P6818 display-top, MLC, DPC, and display
	  clock-generator scanout state handed over by the bootloader.  The
	  MIPI DSI host and panel sequence remain a later ownership stage.
```
