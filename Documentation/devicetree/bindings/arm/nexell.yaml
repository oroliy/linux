## Documentation/devicetree/bindings/arm/nexell.yaml
```yaml
# SPDX-License-Identifier: (GPL-2.0-only OR BSD-2-Clause)
%YAML 1.2
---
$id: http://devicetree.org/schemas/arm/nexell.yaml#
$schema: http://devicetree.org/meta-schemas/core.yaml#

title: Nexell platforms

maintainers:
  - liy <liygfg@gmail.com>

properties:
  $nodename:
    const: "/"

  compatible:
    oneOf:
      - description: Nexell S5P6818 x6818 board
        items:
          - const: nexell,x6818
          - const: nexell,s5p6818

additionalProperties: true

...
```

## Documentation/devicetree/bindings/clock/nexell,s5p6818-clock.yaml
```yaml
# SPDX-License-Identifier: (GPL-2.0-only OR BSD-2-Clause)
%YAML 1.2
---
$id: http://devicetree.org/schemas/clock/nexell,s5p6818-clock.yaml#
$schema: http://devicetree.org/meta-schemas/core.yaml#

title: Nexell S5P6818 Clock Controller

maintainers:
  - liy <liygfg@gmail.com>

description: |
  The S5P6818 clock controller generates the peripheral clocks from the
  external XIN oscillator.  Clock identifiers are defined in
  include/dt-bindings/clock/nexell,s5p6818-clock.h.

properties:
  compatible:
    const: nexell,s5p6818-clk

  reg:
    minItems: 13
    maxItems: 13

  reg-names:
    items:
      - const: clkpwr
      - const: uart0
      - const: timer0
      - const: timer1
      - const: sdmmc0
      - const: sdmmc1
      - const: sdmmc2
      - const: gmac
      - const: usbhost
      - const: mipi
      - const: i2c0
      - const: i2c1
      - const: i2c2

  clocks:
    maxItems: 1

  clock-names:
    items:
      - const: xin

  '#clock-cells':
    const: 1

required:
  - compatible
  - reg
  - reg-names
  - clocks
  - clock-names
  - '#clock-cells'

additionalProperties: false

examples:
  - |
    clock-controller@c0010000 {
        compatible = "nexell,s5p6818-clk";
        reg = <0xc0010000 0x400>,
              <0xc00a9000 0x1000>, <0xc00b9000 0x1000>,
              <0xc00bb000 0x1000>, <0xc00c5000 0x1000>,
              <0xc00cc000 0x1000>, <0xc00cd000 0x1000>,
              <0xc00c8000 0x1000>, <0xc006b000 0x1000>,
              <0xc00ca000 0x1000>, <0xc00ae000 0x1000>,
              <0xc00af000 0x1000>, <0xc00b0000 0x1000>;
        reg-names = "clkpwr", "uart0", "timer0", "timer1",
                    "sdmmc0", "sdmmc1", "sdmmc2", "gmac",
                    "usbhost", "mipi", "i2c0", "i2c1", "i2c2";
        clocks = <&refclk>;
        clock-names = "xin";
        #clock-cells = <1>;
    };
```

## Documentation/devicetree/bindings/display/nexell,s5p6818-display.yaml
```yaml
# SPDX-License-Identifier: (GPL-2.0-only OR BSD-2-Clause)
%YAML 1.2
---
$id: http://devicetree.org/schemas/display/nexell,s5p6818-display.yaml#
$schema: http://devicetree.org/meta-schemas/core.yaml#

title: Nexell S5P6818 Display Scanout Handoff

maintainers:
  - liy <liygfg@gmail.com>

description: |
  The S5P6818 display pipeline (DisplayTop, MLC, DPC, CLKGEN2, MIPI DSI)
  is reprogrammed from the U-Boot scanout state for a native Linux scanout
  configuration.

properties:
  compatible:
    const: nexell,s5p6818-display

  reg:
    maxItems: 6

  reg-names:
    items:
      - const: top
      - const: mlc
      - const: dpc
      - const: clkgen
      - const: mipi
      - const: tieoff

  resets:
    minItems: 7
    maxItems: 7

  reset-names:
    items:
      - const: disp-top
      - const: display
      - const: mipi
      - const: mipi-dsi
      - const: mipi-csi
      - const: mipi-phy-s
      - const: mipi-phy-m

required:
  - compatible
  - reg
  - reg-names
  - resets
  - reset-names

additionalProperties: false

examples:
  - |
    display@c0101000 {
        compatible = "nexell,s5p6818-display";
        reg = <0xc0101000 0x100>,
              <0xc0102000 0x400>,
              <0xc0102800 0x400>,
              <0xc0105000 0x100>,
              <0xc00d0000 0x1000>,
              <0xc0011000 0x100>;
        reg-names = "top", "mlc", "dpc", "clkgen", "mipi", "tieoff";
        resets = <&nexell_reset 70>, <&nexell_reset 71>, <&nexell_reset 72>,
                 <&nexell_reset 73>, <&nexell_reset 74>, <&nexell_reset 75>,
                 <&nexell_reset 76>;
        reset-names = "disp-top", "display", "mipi", "mipi-dsi", "mipi-csi",
                      "mipi-phy-s", "mipi-phy-m";
    };
```

## Documentation/devicetree/bindings/media/nexell,s5p6818-capture.yaml
```yaml
# SPDX-License-Identifier: (GPL-2.0-only OR BSD-2-Clause)
%YAML 1.2
---
$id: http://devicetree.org/schemas/media/nexell,s5p6818-capture.yaml#
$schema: http://devicetree.org/meta-schemas/core.yaml#

title: Nexell S5P6818 CSI-2 receiver and VIP0 capture

maintainers:
  - liy <liygfg@gmail.com>

description: |
  Combined CSI-2 receiver and VIP0 clipper DMA engine. Sensor virtual channel
  zero is routed through CSI output channel one to VIP0. The MIPI register
  block and resets are exclusive; a native DSI display controller using the
  same block must be disabled. RGB simple-framebuffer display is independent.

properties:
  compatible:
    const: nexell,s5p6818-capture
  reg:
    items:
      - description: MIPI CSI register block, including shared PLL
      - description: VIP0 capture register block
      - description: MIPI SRAM EMA tie-off register
  reg-names:
    items:
      - const: csi
      - const: vip
      - const: sram
  interrupts:
    maxItems: 1
  clocks:
    maxItems: 3
  clock-names:
    items:
      - const: mipi
      - const: vip
      - const: source
  resets:
    maxItems: 6
  reset-names:
    items:
      - const: mipi
      - const: csi
      - const: phy
      - const: vip
      - const: dsi
      - const: phy-master
  port:
    $ref: /schemas/graph.yaml#/$defs/port-base
    unevaluatedProperties: false
    properties:
      endpoint:
        $ref: /schemas/media/video-interfaces.yaml#
        unevaluatedProperties: false
        properties:
          data-lanes:
            items:
              - const: 1
              - const: 2
        required:
          - data-lanes
          - remote-endpoint

required:
  - compatible
  - reg
  - reg-names
  - interrupts
  - clocks
  - clock-names
  - resets
  - reset-names
  - port

additionalProperties: false
```

## Documentation/devicetree/bindings/mmc/nexell,s5p6818-dw-mshc.yaml
```yaml
# SPDX-License-Identifier: (GPL-2.0-only OR BSD-2-Clause)
%YAML 1.2
---
$id: http://devicetree.org/schemas/mmc/nexell,s5p6818-dw-mshc.yaml#
$schema: http://devicetree.org/meta-schemas/core.yaml#

title: Nexell S5P6818 DesignWare Mobile Storage Host Controller

maintainers:
  - liy <liygfg@gmail.com>

description: |
  The S5P6818 MMC/SD controller is a Synopsys DesignWare MMC block with
  Nexell-specific clock delay tuning registers.

allOf:
  - $ref: synopsys-dw-mshc.yaml

properties:
  compatible:
    const: nexell,s5p6818-dw-mshc

  nexell,drive-delay:
    $ref: /schemas/types.yaml#/definitions/uint32
    minimum: 0
    maximum: 255
    description: drive clock delay tap value

  nexell,drive-shift:
    $ref: /schemas/types.yaml#/definitions/uint32
    minimum: 0
    maximum: 3
    description: drive clock delay shift value

  nexell,sample-delay:
    $ref: /schemas/types.yaml#/definitions/uint32
    minimum: 0
    maximum: 255
    description: sample clock delay tap value

  nexell,sample-shift:
    $ref: /schemas/types.yaml#/definitions/uint32
    minimum: 0
    maximum: 3
    description: sample clock delay shift value

  nexell,mmc-boost:
    $ref: /schemas/types.yaml#/definitions/uint32
    minimum: 0
    maximum: 1
    description: select the higher clock divider (1) or lower (0)

required:
  - compatible

unevaluatedProperties: false

examples:
  - |
    #include <dt-bindings/interrupt-controller/irq.h>
    #include <dt-bindings/interrupt-controller/arm-gic.h>
    #include <dt-bindings/clock/nexell,s5p6818-clock.h>
    mmc@c0069000 {
        compatible = "nexell,s5p6818-dw-mshc";
        reg = <0xc0069000 0x1000>;
        interrupts = <GIC_SPI 45 IRQ_TYPE_LEVEL_HIGH>;
        clocks = <&clocks NEXELL_CLK_SDMMC2>, <&clocks NEXELL_CLK_SDMMC2>;
        clock-names = "biu", "ciu";
        resets = <&nexell_reset 40>;
        reset-names = "reset";
        bus-width = <4>;
        fifo-depth = <32>;
        clock-frequency = <100000000>;
        max-frequency = <50000000>;
        nexell,drive-delay = <0>;
        nexell,drive-shift = <2>;
        nexell,sample-delay = <0x1c>;
        nexell,sample-shift = <1>;
        nexell,mmc-boost = <0>;
        non-removable;
    };
```

## Documentation/devicetree/bindings/net/nexell,s5p6818-dwmac.yaml
```yaml
# SPDX-License-Identifier: (GPL-2.0-only OR BSD-2-Clause)
%YAML 1.2
---
$id: http://devicetree.org/schemas/net/nexell,s5p6818-dwmac.yaml#
$schema: http://devicetree.org/meta-schemas/core.yaml#

title: Nexell S5P6818 DWMAC Ethernet Controller

maintainers:
  - liy <liygfg@gmail.com>

description: |
  The S5P6818 Ethernet controller is a Synopsys DWMAC1000 block.  The
  external RTL8211E PHY provides the RGMII delays via strap pins and has a
  board-controlled reset GPIO.

select:
  properties:
    compatible:
      contains:
        const: nexell,s5p6818-dwmac
  required:
    - compatible

allOf:
  - $ref: snps,dwmac.yaml#

properties:
  compatible:
    const: nexell,s5p6818-dwmac

  clocks:
    items:
      - description: GMAC main clock
      - description: GMAC PCLK

  clock-names:
    items:
      - const: stmmaceth
      - const: pclk

  resets:
    maxItems: 1

  reset-names:
    const: stmmaceth

  nexell,clock-controller:
    $ref: /schemas/types.yaml#/definitions/phandle
    description: phandle of the Nexell clock controller containing GMAC CLKGEN

unevaluatedProperties: false

examples:
  - |
    #include <dt-bindings/interrupt-controller/irq.h>
    #include <dt-bindings/interrupt-controller/arm-gic.h>
    #include <dt-bindings/clock/nexell,s5p6818-clock.h>
    ethernet@c0060000 {
        compatible = "nexell,s5p6818-dwmac";
        reg = <0xc0060000 0x2000>;
        interrupts = <GIC_SPI 48 IRQ_TYPE_LEVEL_HIGH>;
        interrupt-names = "macirq";
        clocks = <&clocks NEXELL_CLK_GMAC>, <&clocks NEXELL_CLK_GMAC_TX>;
        clock-names = "stmmaceth", "pclk";
        nexell,clock-controller = <&clocks>;
        resets = <&nexell_reset 50>;
        reset-names = "stmmaceth";
        phy-mode = "rgmii";
        max-speed = <1000>;
        snps,clk-csr = <4>;
        phy-handle = <&gmac_phy>;

        mdio {
            #address-cells = <1>;
            #size-cells = <0>;
            ethernet-phy@4 {
                reg = <4>;
            };
        };
    };
```

## Documentation/devicetree/bindings/phy/nexell,s5p6818-usb2-phy.yaml
```yaml
# SPDX-License-Identifier: (GPL-2.0-only OR BSD-2-Clause)
%YAML 1.2
---
$id: http://devicetree.org/schemas/phy/nexell,s5p6818-usb2-phy.yaml#
$schema: http://devicetree.org/meta-schemas/core.yaml#

title: Nexell S5P6818 USB 2.0 Host PHY

maintainers:
  - liy <liygfg@gmail.com>

description: |
  The S5P6818 USB 2.0 host PHY owns the shared TIEOFF, clocks and reset
  used by the EHCI and OHCI host controllers. PHY index 0 is the EHCI
  instance and PHY index 1 is the OHCI instance.

properties:
  compatible:
    const: nexell,s5p6818-usb-host-phy

  reg:
    maxItems: 1

  clocks:
    items:
      - description: USB host controller clock
      - description: USB host reference clock

  clock-names:
    items:
      - const: usbhost
      - const: usbhost-ref

  resets:
    maxItems: 1

  reset-names:
    const: host

  '#phy-cells':
    const: 1

required:
  - compatible
  - reg
  - clocks
  - clock-names
  - resets
  - reset-names
  - '#phy-cells'

additionalProperties: false

examples:
  - |
    #include <dt-bindings/clock/nexell,s5p6818-clock.h>
    usb-host-phy@c0011000 {
        compatible = "nexell,s5p6818-usb-host-phy";
        reg = <0xc0011000 0x100>;
        clocks = <&clocks NEXELL_CLK_USBHOST>,
                 <&clocks NEXELL_CLK_USBHOST_REF>;
        clock-names = "usbhost", "usbhost-ref";
        resets = <&nexell_reset 56>;
        reset-names = "host";
        #phy-cells = <1>;
    };
```

## Documentation/devicetree/bindings/pinctrl/nexell,s5p6818-pinctrl.yaml
```yaml
# SPDX-License-Identifier: (GPL-2.0-only OR BSD-2-Clause)
%YAML 1.2
---
$id: http://devicetree.org/schemas/pinctrl/nexell,s5p6818-pinctrl.yaml#
$schema: http://devicetree.org/meta-schemas/core.yaml#

title: Nexell S5P6818 Pin Controller

maintainers:
  - liy <liygfg@gmail.com>

description: |
  The S5P6818 pin controller exposes six GPIO banks (gpioa-gpioe and
  the always-on "alive" bank) and pin multiplexing via child nodes that
  name pins like "gpiod-14".

properties:
  compatible:
    const: nexell,s5p6818-pinctrl

  reg:
    minItems: 6
    maxItems: 6

  '#pinctrl-cells':
    const: 0

  alive:
    type: object
    additionalProperties: false
    properties:
      gpio-controller: true
      '#gpio-cells':
        const: 2
    required:
      - gpio-controller
      - '#gpio-cells'

patternProperties:
  '^gpio[a-e]$':
    type: object
    additionalProperties: false
    properties:
      gpio-controller: true
      '#gpio-cells':
        const: 2
    required:
      - gpio-controller
      - '#gpio-cells'

  '^.*-pins$':
    type: object
    description: pin configuration subnode
    additionalProperties: false
    properties:
      nexell,pins:
        $ref: /schemas/types.yaml#/definitions/string-array
        description: array of pins to configure, e.g. "gpiod-14"
      nexell,pin-function:
        $ref: /schemas/types.yaml#/definitions/uint32
        description: mux function selection value
      nexell,pin-pull:
        $ref: /schemas/types.yaml#/definitions/uint32
        description: pull-up/pull-down selection value
      nexell,pin-strength:
        $ref: /schemas/types.yaml#/definitions/uint32
        description: drive strength selection value
      nexell,pin-dir:
        $ref: /schemas/types.yaml#/definitions/uint32
        description: pin direction (1 = output, 0 = input)
      nexell,pin-val:
        $ref: /schemas/types.yaml#/definitions/uint32
        description: output level driven on the pin
    anyOf:
      - required:
          - nexell,pins
    required:
      - nexell,pins

required:
  - compatible
  - reg

additionalProperties: false

examples:
  - |
    pinctrl@c001a000 {
        compatible = "nexell,s5p6818-pinctrl";
        reg = <0xc001a000 0x1000>,
              <0xc001b000 0x1000>,
              <0xc001c000 0x1000>,
              <0xc001d000 0x1000>,
              <0xc001e000 0x1000>,
              <0xc0010800 0x0200>;
        #pinctrl-cells = <0>;

        gpioa: gpioa {
            gpio-controller;
            #gpio-cells = <2>;
        };

        uart0_pins: uart0-pins {
            nexell,pins = "gpiod-14", "gpiod-18";
            nexell,pin-function = <1>;
            nexell,pin-pull = <2>;
            nexell,pin-strength = <0>;
        };
    };
```

## Documentation/devicetree/bindings/reset/nexell,s5p6818-reset.yaml
```yaml
# SPDX-License-Identifier: (GPL-2.0-only OR BSD-2-Clause)
%YAML 1.2
---
$id: http://devicetree.org/schemas/reset/nexell,s5p6818-reset.yaml#
$schema: http://devicetree.org/meta-schemas/core.yaml#

title: Nexell S5P6818 Reset Controller

maintainers:
  - liy <liygfg@gmail.com>

description: |
  The S5P6818 reset controller manages the module resets.  Reset line
  identifiers are defined in
  include/dt-bindings/reset/nexell,s5p6818-reset.h.

properties:
  compatible:
    const: nexell,s5p6818-reset

  reg:
    maxItems: 1

  '#reset-cells':
    const: 1

required:
  - compatible
  - reg
  - '#reset-cells'

additionalProperties: false

examples:
  - |
    reset-controller@c0012000 {
        compatible = "nexell,s5p6818-reset";
        reg = <0xc0012000 0x0c>;
        #reset-cells = <1>;
    };
```
